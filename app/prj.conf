## CMakeLists.txt
```
cmake_minimum_required(VERSION 3.20.0)

find_package(Zephyr REQUIRED HINTS $ENV{ZEPHYR_BASE})

project(drone)

add_subdirectory(includes)

target_sources(app PRIVATE src/main.c src/mpu6050/mpu6050.c)

target_link_libraries(app PRIVATE drone_headers)
```

## prj.conf
```kconfig
# enable GPIO
CONFIG_GPIO=y

# enable uart driver
CONFIG_SERIAL=y

# enable console
CONFIG_CONSOLE=y
CONFIG_UART_CONSOLE=y
CONFIG_USB_DEVICE_STACK=y
CONFIG_USB_CDC_ACM=y
CONFIG_USB_DRIVER_LOG_LEVEL_INF=y


# MPU6050
CONFIG_I2C=y
CONFIG_SENSOR=y
CONFIG_MPU6050=y
CONFIG_CONSOLE_SUBSYS=y
CONFIG_MPU6050_TRIGGER_NONE=y
CONFIG_CBPRINTF_FP_SUPPORT=y
CONFIG_PICOLIBC=y
```

## src/main.c
```c
/* ************************************************************************** */
/*                                                                            */
/*                              NEVERBACKPING                                 */
/*                          Embedded RTOS Drone Project                       */
/*                                                                            */
/* ************************************************************************** */

#include "../includes/drone.h"
#include "../includes/mpu6050.h"
#include "zephyr/kernel.h"

int	main(void)
{
	while (1)
	{
		k_sleep(K_MSEC(1000));
	}
	return (0);
}
```
